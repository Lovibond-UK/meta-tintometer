## conf/layer.conf
```bitbake
# We have a conf and classes directory, add to BBPATH
BBPATH .= ":${LAYERDIR}"

# We have recipes-* directories, add to BBFILES
BBFILES += "${LAYERDIR}/recipes-*/*/*.bb \
            ${LAYERDIR}/recipes-*/*/*.bbappend"

BBFILE_COLLECTIONS += "meta-tintometer"
BBFILE_PATTERN_meta-tintometer = "^${LAYERDIR}/"
BBFILE_PRIORITY_meta-tintometer = "100"

LAYERSERIES_COMPAT_meta-tintometer = "warrior zeus hardknott kirkstone mickledore"
```
